
; _usb_demo.inc
;
; This macrofile has been generated by TASKING EDE 
; for the 'usb_demo' project.
;

.define _REGUSER113_DEF	'1'

;
; Startup Configuration
;











.define _WATCHDOG_DISABLE '1'

.define _SYNC_ON_HALT '1'










; 
;	External Boot Memory Configuration
;
.define _BOOTCFG_VALUE '0x00008060'

;
;	PMU Control Register Configuration
;
.define _PMU_CON_VALUE '0x00000002'

;
; Bus configuration
;

; register settings for TriBoard (TC11IB) with SDRAM
.define _TARGET_BOARD           'TC1130_SDRAM'
.define _EBUCON_VALUE		'0x00F9FF68'
.define _ADDSEL0_VALUE		'0xA4000051'
.define _BUSCON0_VALUE		'0x00860000'
.define _BUSAP0_VALUE		'0x23ff0100'
.define _ADDSEL1_VALUE		'0xA0000031'
.define _BUSCON1_VALUE		'0x30B20000'
.define _BUSAP1_VALUE		'0x22070000'
.define _ADDSEL2_VALUE		'0xA2000031'
.define _BUSCON2_VALUE		'0x30B20000'
.define _BUSAP2_VALUE		'0x22070000'
.define _BFCON_VALUE		'0x00000053'
.define _SDRMCON0_VALUE		'0x01161075'
.define _SDRMOD0_VALUE		'0x00000023'
.define _SDRMREF0_VALUE		'0x000000D7'
; End of file
